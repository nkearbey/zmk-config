## config/boards/shields/rae_dux/Kconfig.defconfig
```kconfig
# Copyright (c) 2022 The ZMK Contributors
# SPDX-License-Identifier: MIT

config ZMK_BLE
	default y

config ZMK_USB
	default y

if SHIELD_RAE_DUX_DONGLE || SHIELD_RAE_DUX_LEFT || SHIELD_RAE_DUX_RIGHT

config ZMK_KEYBOARD_NAME
	default "rae-dux"

endif



if SHIELD_RAE_DUX_DONGLE_LEFT || SHIELD_RAE_DUX_DONGLE_RIGHT || SHIELD_RAE_DUX_RIGHT

config ZMK_SPLIT
	default y

endif



if SHIELD_RAE_DUX_DONGLE || SHIELD_RAE_DUX_LEFT

config ZMK_SPLIT
	default y

config ZMK_SPLIT_BLE_ROLE_CENTRAL
	default y

endif
```

## config/boards/shields/rae_dux/Kconfig.shield
```kconfig
# Copyright (c) 2022 The ZMK Contributors
# SPDX-License-Identifier: MIT

config SHIELD_RAE_DUX_LEFT
	def_bool $(shields_list_contains,rae_dux_left)

config SHIELD_RAE_DUX_RIGHT
	def_bool $(shields_list_contains,rae_dux_right)

config SHIELD_RAE_DUX_DONGLE_LEFT
	def_bool $(shields_list_contains,rae_dux_dongle_left)

config SHIELD_RAE_DUX_DONGLE_RIGHT
	def_bool $(shields_list_contains,rae_dux_dongle_right)

config SHIELD_RAE_DUX_DONGLE
	def_bool $(shields_list_contains,rae_dux_dongle)
```
